## libs/libbart/Config.in
```kconfig
config PACKAGE_libbart
    tristate
    select SAH_LIB_BART

if PACKAGE_libbart

menu "Select libbart build options"
    depends on PACKAGE_libbart

config SAH_LIB_BART
    bool "Build Backup and Restore tools (BaRt) library"
    default y

config SAH_LIB_BART_PRPL
    bool "Build the bart library for PRPL when using PCM (PersistentConfigurationManager)"
    default n

endmenu

endif
```

## mods/mod-deviceinfo-swversion-hash/Config.in
```kconfig
config PACKAGE_mod-deviceinfo-swversion-hash
    tristate
    select SAH_AMX_ADD_DBREADY_SCRIPT

if PACKAGE_mod-deviceinfo-swversion-hash

menu "Select mod-deviceinfo-swversion-hash build options"
    depends on PACKAGE_mod-deviceinfo-swversion-hash

config SAH_AMX_ADD_DBREADY_SCRIPT
    bool "Build deviceinfo-manager's module that handles the software version hash"
    default y

config SAH_AMX_DBREADY_SCRIPT_START_ORDER
    int "Start-up order for the script that saves the hash code into the file"
    default 99

endmenu

endif
```

## plugins/tr181-gatewayinfo/Config.in
```kconfig
config PACKAGE_tr181-gatewayinfo
    tristate
    select SAH_AMX_TR181_GATEWAYINFO

if PACKAGE_tr181-gatewayinfo

menu "Select tr181-gatewayinfo build options"
    depends on PACKAGE_tr181-gatewayinfo

config SAH_AMX_TR181_GATEWAYINFO
    bool "Build a tr181 compatible gateway info plugin"
    default y

config SAH_AMX_TR181_GATEWAYINFO_PLATFORM
    string "Platform that is used, can be 'prpl' or 'sop'"
    default "prpl"

endmenu

endif
```
